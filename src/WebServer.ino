/*
  WebServer.ino

  !!! for history see end of file !!!

  ToDos:    ???

  hints:    ???
*/


#include  "version.h"
#include  "WebServer.h"
#include  "Homa.h"
#include  "timer.h"
#include  "ToF.h"
#include  "WiFi.h"
#include  <ESP8266mDNS.h>


// -----------------------------------------
// Server stuff
//------------------------------------------
//HTTP
ESP8266WebServer server(MyServerPort);

const char H_HOME_PAGE[] PROGMEM = {
  //  this is the page frame for all webpages
  //  all pages should be generated by replacing the {pagename}-fields width
  //  the webpages for the particular pages
  "<!DOCTYPE html>\r\n"
  "<html lang=\"de\">\r\n"
  "<head>\r\n"
  "<meta charset=\"utf-8\">\r\n"
  "<TITLE>{title}</TITLE>\r\n"
  "<meta name=\"viewport\" content=\"width=device-width, initial-scale=0.5\">\r\n"
  "<style>\r\n"
  "body {\r\n"
    "  font-family: Verdana, sans-serif;\r\n"
    "  font-size: 87.5%;\r\n"
    "  background-color: #ffe9b4;\r\n"
    "  color: black;\r\n"
    "  padding: 0;\r\n"
    "  margin:0;\r\n"
  "}\r\n"

  "div1 {\r\n"
    "  width: 100%;\r\n"
    "  color: black;\r\n"
    "  padding: 10px;\r\n"
    "  position: absolute;\r\n"
    "  top: 60px;\r\n"
    "  left: 150px;\r\n"
  "}\r\n"

  ".vertical-menu a {\r\n"
    "  background-color: #eee;\r\n"
    "  color: black;\r\n"
    "  display: block;\r\n"
    "  padding: 12px;\r\n"
    "  text-decoration: none;\r\n"
  "}\r\n"

  ".vertical-menu {\r\n"
    "  width: 100px;\r\n"
    "  background-color: #e9b4;\r\n" //menuefarbe ???
  "}\r\n"

  ".vertical-menu a:hover {\r\n"
    "  background-color: #4CAFf0;\r\n"
  "}\r\n"

  ".vertical-menu a.active {\r\n"
    "  background-color: #4CAFf0;\r\n"
    "  color: white;\r\n"
  "}\r\n"

  "</style>\r\n"
  "</head>\r\n"
  "<body>\r\n"

  "<h1>{hostname}</h1>\r\n"
  "<div1>{apptext}</div1>\r\n"
  "<div class=\"vertical-menu\">\r\n"
  "{apppage}"
  "{mainpage}"
  "{networkpage}"
  "{confpage}"
  "</div>\r\n"
  "</body>\r\n"
  "</html>\r\n"};

const char H_APPPAGE[]  PROGMEM = {
#if (H_DS1820 == H_TRUE)
  "  <a href=" W_URL_DS1820      ">DS1820</a><br>\r\n"
#elif (H_TOF == H_TRUE)
  "  <a href=" W_URL_TOF         ">ToF</a><br>\r\n"
#elif (H_SWITCH == H_TRUE)
  "  <a href=" W_URL_SWITCH      ">Switch</a><br>\r\n"
  "{apppagemenu}"
#endif
  "  <a href=" W_URL_STATUS      ">Status</a><br>\r\n"};

const char H_APPPAGEMENU[]  PROGMEM = {
#if (H_SWITCH == H_TRUE)
  "  <a href=" W_URL_ON          ">Ein</a><br>\r\n"
  "  <a href=" W_URL_OFF         ">Aus</a><br>\r\n"};
#elif (H_DS1820 == H_TRUE) || (H_TOF == H_TRUE)
          };
#endif

const char H_MAINPAGE[] PROGMEM = {
  "  <a href=" W_URL_NETWORK     ">Network</a>\r\n "
  "  <a href=" W_URL_CONFIG      ">Config</a>\r\n "};

const char H_NETWORKPAGE[] PROGMEM = {
  "  <a href=" W_URL_STATUS      ">Status</a><br>\r\n"
  "  <a href=" W_URL_SCAN        ">Scan</a>\r\n "
  "  <a href=" W_URL_STAMODE     ">STA-Mode</a>\r\n"
  "  <a href=" W_URL_APMODE      ">AP-Mode</a>\r\n"
  "  <a href=" W_URL_FIX_IP      ">Fixed IP</a></p>\r\n"};

const char H_CONFPAGE[] PROGMEM = {
  "  <a href= " W_URL_STATUS     ">Status</a><br>\r\n"
#if (H_DS1820 == H_TRUE)||(H_TOF == H_TRUE)
  "  <a href=" W_URL_MEASCYC     ">MeasCyc</a>\r\n "
#endif
  "  <a href=" W_URL_TRANSCYC    ">TransCyc</a>\r\n "
  "  <a href=" W_URL_PAGERELOAD  ">Pagereload</a>\r\n "
  "  <a href=" W_URL_SERVER      ">Server</a>\r\n "
  "  <a href=" W_URL_SERVICE     ">Service</a>\r\n "
  "  <a href=" W_URL_HOSTNAME    ">Name</a>\r\n"
  "  <a href=" W_URL_LED         ">LED</a>\r\n"
  "  <a href=" W_URL_DEFAULT     ">set defaults</a>\r\n"
  "  <a href=" W_URL_RESET       ">Reset</a></p>\r\n"
  "  <form method='POST' action='/update' enctype='multipart/form-data'><input type='file' name='update'><input type='submit' value='Update'></form>"};


const char H_RADIO_WIFI_START[] PROGMEM = {
  "<form>\r\n"
  "<p>mit welchem Netzwerk soll eine Verbindung hergestellt werden?</p>\r\n"};

const char H_RADIO_WIFI_LINE[] PROGMEM = {
  "<input type=\"radio\" name=\"SSID\" value=\"{SSID}\">  {CRYPT}{SSID}   ->   (Signal: {RSSI})\r\n"};

const char H_RADIO_WIFI_END[] PROGMEM = {
    "<br><br>\r\n"
    "<input type=\"password\" name=\"pass\"> </label>\r\n"
    "<input type=\"submit\" value=\"senden\">\r\n"
    "</form>\r\n"
  };

const char H_RADIO_LED_START[] PROGMEM = {
    "<form>\r\n"
    "<p> soll die LED ein- oder ausgeschaltet sein? Aktuell ist sie {ledtext}.</p>\r\n"};

const char H_RADIO_LED_LINE[] PROGMEM = {
    "<input type=\"radio\" name=\"Led\" value=\"On\">  On\r\n"
    "<input type=\"radio\" name=\"Led\" value=\"Off\">  Off\r\n"};

const char H_RADIO_LED_END[] PROGMEM = {
    "<br><br>\r\n"
    "<input type=\"submit\" value=\"senden\">\r\n"
    "</form>\r\n"
  };

const char H_NAME[] PROGMEM = {
    "<form>\r\n"
    "<p> {nametext}</p>\r\n"
    "<input type=\"text\" name=\"{urltext}\"> </label>\r\n"
    "<input type=\"submit\" value=\"senden\">\r\n"
    "</form>\r\n"
  };

String  WebPage = "";
String  output = "";

void WebServerStart(){
  DBGF("WebServerStart()")
  server.on((W_URL_ROOT), [](){
    server.send(200, (W_TEXT_HTML), WebPage);
    sysflag.CntPageDelivered++;
  });

# if defined(WLAN_SWITCH_SB) || defined(WLAN_SWITCH_S20)
  server.on(("/" W_URL_ON), [](){
    DBGF("HandleOn()");
    DIG_WRITE( H_LED_PIN, LOW);
    if( DIG_READ( H_RELAY_PIN) == LOW )
      cycles++;
    DIG_WRITE(H_RELAY_PIN, HIGH);
    handleSwitch();
    sysflag.TransmitCycle = 0; // send status immediately
    delay(1000);
  });
  server.on(("/" W_URL_OFF), [](){
    DBGF("HandleOff()");
    DIG_WRITE( H_LED_PIN, HIGH);
    if( DIG_READ( H_RELAY_PIN) == HIGH )
      cycles++;
    DIG_WRITE( H_RELAY_PIN, LOW);
    handleSwitch();
    sysflag.TransmitCycle = 0; // send status immediately
    delay(1000);
  });
# endif

#if (H_DS1820 == H_TRUE)
  server.on(F("/" W_URL_DS1820), handleDS1820);
# elif (H_SWITCH == H_TRUE)
  server.on(F("/" W_URL_SWITCH), handleSwitch);
# elif (H_TOF == H_TRUE)
    server.on(F("/" W_URL_TOF), handleToF);
# endif
  server.on(F("/" W_URL_SERVER), handleServer);
  server.on(F("/" W_URL_SERVICE), handleService);
  server.onNotFound( handleNotFound );
  server.on(F("/" W_URL_SCAN), handleScan);
  server.on(F("/" W_URL_STATUS), handleStatusRequest);
  server.on(F("/" W_URL_RESET), handleReset);
  server.on(F("/" W_URL_APMODE), handleAPMode);
  server.on(F("/" W_URL_STAMODE), handleSTAMode);
  server.on(F("/" W_URL_HOSTNAME), handleHostName);
  server.on(F("/" W_URL_LED), handleLED);
  server.on(F("/" W_URL_DEFAULT), handleSetDefault);
  server.on(F("/" W_URL_NETWORK), handleNetPage);
  server.on(F("/" W_URL_CONFIG), handleConfPage);
  server.on(F("/" W_URL_PAGERELOAD), handlePagereload);
  server.on(F("/" W_URL_MEASCYC), handleMeasCyc);
  server.on(F("/" W_URL_TRANSCYC), handleTransCyc);

  server.on(F("/update"), HTTP_POST, []() {
    DBGF("handleUpdate_part1()");
    server.sendHeader(F("Connection"), "close");
    sysflag.CntPageDelivered++;
    server.send(200, F(W_TEXT_PLAIN), (Update.hasError()) ? F("FAIL") : F("OK"));
    ESP.restart();
  }, []() {
    //DBGF("handleUpdate_part2()");
    char buf[80];
    HTTPUpload& upload = server.upload();
    yield();
    if (upload.status == UPLOAD_FILE_START) {
      DBGLN("UPLOAD_FILE_START");
      Serial.setDebugOutput(true);
      WiFiUDP::stopAll();
      Serial.printf(("Update: %s\n"), upload.filename.c_str());
      uint32_t maxSketchSpace = (ESP.getFreeSketchSpace() - 0x1000) & 0xFFFFF000;
      DBGL("maxSketchSpace: ");
      sprintf(buf, "Flash size: 0x%x; needed: 0x%x Byte; row needed 0x%x", ESP.getFlashChipSize(), maxSketchSpace, ESP.getFreeSketchSpace());
      DBGLN(buf);
      sprintf(buf, "\r\n act. Sketchsize: 0x%x", ESP.getSketchSize());
      DBGLN(buf);
      sprintf(buf, "\r\n act. Chipsize: 0x%x", ESP.getFlashChipSize());
      DBGLN(buf);
      if (!Update.begin(maxSketchSpace+0x1000)) { //start with max available size
        DBGLN("could not begin");
        Update.printError(Serial);
      }
    } else if (upload.status == UPLOAD_FILE_WRITE) {
      DBG(".");
      if (Update.write(upload.buf, upload.currentSize) != upload.currentSize) {
        DBGLN("Update.write");
        Update.printError(Serial);
      }
    } else if (upload.status == UPLOAD_FILE_END) {
      DBGLN("\r\nUPLOAD_FILE_END");
      if (Update.end(true)) { //true to set the size to the current progress
        DBGLN ("Update OK");
        Serial.printf("Update Success: %u, 0x%x\nRebooting...\n", upload.totalSize, upload.totalSize);
      } else {
        DBGLN ("Update failed");
        Update.printError(Serial);
      }
      Serial.setDebugOutput(false);
    }
    yield();
  });

  server.begin();
}

/*  all webserver handlers
 */
void handleSetDefault(){
  DBGF("handleSetDefaults()");
  buildConfPage( F("set every thing to defaults") );
  sysflag.CntPageDelivered++;
  server.send(200, F(W_TEXT_HTML), WebPage);
  SetToDefault();
//  DEAD
  delay(10000);
  ESP.restart();
}

void handleNetPage(){
  DBGF("handleNetPage()");
  buildNetworkPage(F(""));
  sysflag.CntPageDelivered++;
  server.send(200, F(W_TEXT_HTML), WebPage);
}

void handleConfPage(){
  DBGF("handleConftPage()");
  buildConfPage(F(""));
  sysflag.CntPageDelivered++;
  server.send(200, F(W_TEXT_HTML), WebPage);
}

void handleServer() {
  int x;

  DBGF("handleServer()")
  x = checkInput(F("an welchen Server soll gesendet werden?"), F(W_URL_SERVER));
  if( x > 0 ){
    strncpy( cfg.server, server.arg(server.args()-1).c_str(), x);
    cfg.server[x] = 0;
    SaveConfig();
  }
}

#if (H_DS1820 == H_TRUE)
void handleDS1820(){
  DBGF("HandleDS1820()")
  String message = F("Number of devices: ");
  message += numberOfDevices;
  message += F("\r\n<br>");

  message += F("<table border='1'>\r\n");
  message += F("<tr><td>Device ID</td><td>Temperature</td></tr>\r\n");
  message += BuildDS1820Page();
  message += F("</table>\r\n");
  buildAppPage(message);
  sysflag.CntPageDelivered++;
  server.send(200, F(W_TEXT_HTML), WebPage );
  sysflag.CntPageDelivered++;
}

#elif (H_TOF == H_TRUE)
void handleToF(){
  DBGF("handleToF()")
  String message = F("<h1>Distance: </h1>");

  //message += F("\r\n<br>");
  message += BuildToFPage();
  buildAppPage(message);

  server.send(200, F(W_TEXT_HTML), WebPage );
  sysflag.CntPageDelivered++;
}
#elif (H_SWITCH == H_TRUE)
void handleSwitch(){
  String message = F("");
  char cyc[10];

  DBGF("handleSwitch()")
  message += BuildSwitchPage();
  buildAppPage(message);
  itoa (cfg.PageReload, cyc, 10);
  DBGL("Pagereload: ");
  DBGL ( cyc );
  DBGNL(" sec.");
  WebPage += F("<meta http-equiv=\"refresh\" content=\"");
  WebPage += String( cyc );
  WebPage += F("\">");
  sysflag.CntPageDelivered++;
  server.send(200, F(W_TEXT_HTML), WebPage );
  sysflag.CntPageDelivered++;
}
# endif

void handleStatusRequest(){
  DBGF("handleStatusRequest()");
  BuildStatusPage();
}

void handleNotFound(){
  DBGF("HandleNotFound()")
  String message = F("404: Not Found");
  message += F("\nURI: ");
  message += server.uri();
  message += F("\nMethod: ");
  message += (server.method() == HTTP_GET)?F("GET"):F("POST");
  message += F("\nArguments: ");
  message += server.args();
  message += F("\n");
  for (uint8_t i=0; i<server.args(); i++){
    message += " " + server.argName(i) + F(": ") + server.arg(i) + F("\n");
  }
  DBGL(message)
  sysflag.CntPageDelivered++;
  server.send(404, F(W_TEXT_HTML), message);
}

void handleService(){
  int x;

  DBGF("handleService()")
  x = checkInput(F("wie lautet der Service?"), F(W_URL_SERVICE));
  if( x ){
    strncpy( cfg.service, server.arg(server.args()-1).c_str(), x);
    cfg.service[x] = 0;
    SaveConfig();
  }
}

void handleLED(){
  String output="";

  DBGF("handleLED()")
  output = FPSTR(H_RADIO_LED_START);
  cfg.LED == H_TRUE ? output.replace(F("{ledtext}"), F("an")) : output.replace(F("{ledtext}"), F("aus"));
  output += FPSTR(H_RADIO_LED_LINE);
  output += FPSTR(H_RADIO_LED_END);
  buildConfPage (output);
  DBGF(WebPage)
  sysflag.CntPageDelivered++;
  server.send(200, F(W_TEXT_HTML), WebPage);
  DBGF("LED ist jetzt: ");
  DBGF(cfg.LED);
//  DBGF(WebPage)

  DBGF(server.args());
  //x = server.arg(server.args()-1);
  DBGF(server.arg(server.args()-1));
  if(server.args() == 1){
    server.arg(server.args()-1) == "On" ? cfg.LED = H_TRUE : cfg.LED = H_FALSE;
    DBGF(cfg.LED);
    SaveConfig();
    output = F("Yippie");
    buildConfPage (output);
    sysflag.CntPageDelivered++;
    DBGF(WebPage)
    server.send(200, F(W_TEXT_HTML), WebPage);
  }
}

void handleHostName(){
  int x;

  DBGF("handleHostName()")
  x = checkInput(F("wie soll das Ding denn heissen?"), F(W_URL_HOSTNAME));
  if( x ){
    strncpy( cfg.hostname, server.arg(server.args()-1).c_str(), x);
    cfg.hostname[x] = 0;
    SaveConfig();
    handleReset();
  }
}

void handleMeasCyc(){
  int x;
  char buf[MAXCHAR];

  DBGF("handleMeasCyc()")
  x = checkInput(F("wie oft soll gemessen werden?"), F(W_URL_MEASCYC));

  if( x ){
    strncpy( buf, server.arg(server.args()-1).c_str(), x);
    buf[x]=0;
    if (string_isNumber(buf))
    {
      cfg.MeasuringCycle = atol(buf);
      SaveConfig();
      sysflag.MeasuringCycle = cfg.MeasuringCycle;
    }
  }
}

void handleTransCyc(){
  int x;
  char buf[MAXCHAR];

  DBGF("handleTransCyc()")
  x = checkInput(F("wie oft soll zum Server gesendet werden?"), F(W_URL_TRANSCYC));
  if( x ){
    strncpy( buf, server.arg(server.args()-1).c_str(), x);
    buf[x] = 0;
    if (string_isNumber(buf))
    {
      cfg.TransmitCycle = atol(buf);
      SaveConfig();
      sysflag.TransmitCycle = cfg.TransmitCycle;
      if(!sysflag.TransmitCycle) LEDControl(BLKMODEFLASH, BLKFLASHOFF);
    }
  }
}

void handlePagereload(){
  int x;
  char buf[MAXCHAR];

  DBGF("handlePagereload()")
  x = checkInput("wie oft soll die Seite neu geladen werden?", W_URL_PAGERELOAD);
  if( x ){
    strncpy( buf, server.arg(server.args()-1).c_str(), x);
    buf[x]=0;
    if (string_isNumber(buf))
    {
      cfg.PageReload = atol(buf);
      SaveConfig();
    }
  }
}

void handleSTAMode(){
  DBGF("handleSTAMode()")
  buildNetworkPage( F("switching to STA-Mode") );
  sysflag.CntPageDelivered++;
  server.send(200, F(W_TEXT_HTML), WebPage);
  delay(1000);
  sysflag.mode = MODE_CHG_TO_STA;
}

void handleAPMode(){
  DBGF("handleAPMode()")
  String message= F("look me up under 192.168.4.1 (my name is: ");
  message += (String)cfg.APname;
  message += F(")");
  buildNetworkPage(message);
  sysflag.CntPageDelivered++;
  server.send(200, F(W_TEXT_HTML), WebPage);
  delay(1000);
  sysflag.mode = MODE_CHG_TO_AP;
}

void handleReset(){
  DBGF("handleReset()")
  buildConfPage (F("restart in a few seconds<br> please reload page"));
  sysflag.CntPageDelivered++;
  server.send(200, F(W_TEXT_HTML), WebPage);
  delay(1000);
  ESP.restart();
//  DEAD
//  delay(10000);

}

void handleScan(){
  String message;
  int x;

  DBGF("handleScan()")

  if( server.args() == 0 ){
    ScanStart();
  }
  else
    if( server.args() == 2 ){
      ScanEnd();
// string laenge von SSID und password ueberpruefen
      x = strlen(server.arg(server.args()-2).c_str());
      strncpy( cfg.SSID, server.arg(server.args()-2).c_str(), x);
      cfg.SSID[x] = 0;
      x = strlen(server.arg(server.args()-1).c_str());
      strncpy( cfg.password, server.arg(server.args()-1).c_str(), x);
      cfg.password[x] = 0;
      SaveConfig();
      handleSTAMode();
      WebServerStart();
    }
    else {
      ScanStart();
    }
}

void ScanEnd(){
  DBGF("ScanEnd()")
  buildNetworkPage(F(""));
  // Fehlerhandling wenn parameter falsch und handling wenn alles ok
  sysflag.CntPageDelivered++;
  server.send(200, F(W_TEXT_HTML), WebPage);
}

void ScanStart(){
  DBGF("ScanStart()")
  //printUrlArg();
  output = F("");
  char buf[80];

  delay(100);
  // WiFi.scanNetworks will return the number of networks found
  int n = WiFi.scanNetworks();
  if (n == 0)
    output += F("no networks found");
  else
  {
    DBGL(n);
    DBG((" networks found"));
    Serial.println("");
    output += FPSTR(H_RADIO_WIFI_START);

    for (int i = 0; i < n; ++i)
    {
      // Print SSID and RSSI for each network found
      output += F("<br>");
      DBGLN(i + 1);
      DBG(": ");
      DBG((WiFi.encryptionType(i) == ENC_TYPE_NONE)?"  ":"* ");
      DBG(WiFi.SSID(i));
      output += FPSTR(H_RADIO_WIFI_LINE);
      if( WiFi.encryptionType(i) == ENC_TYPE_NONE )
        output.replace( F("{CRYPT}"),F(" - "));
      else
        output.replace( F("{CRYPT}"),F(" * "));
      output.replace(F("{SSID}"), WiFi.SSID(i));
      ltoa(WiFi.RSSI(i), buf, 10);
      output.replace(F("{RSSI}"), (String)(buf));
      DBG(" (");
      DBG(WiFi.RSSI(i));
      DBG(")");
      Serial.println("");
      delay(10);
    }
    output += F("<h6>");
    output += FPSTR(H_RADIO_WIFI_END);
    output += F("</h6>");
    buildNetworkPage(output);
  }
  sysflag.CntPageDelivered++;
  server.send(200, F(W_TEXT_HTML), WebPage);
}

/*  all webpage building routines
 *
 */
 String buildPageFrame(String str) {
   // building the frame for all Pages
   // setup the pages with the content thats the same for all pages
   DBGF("buildPageFrame(void)")
   WebPage = FPSTR(H_HOME_PAGE);
   WebPage.replace(F("{hostname}"), (String)cfg.hostname);
   WebPage.replace(F("{title}"), (String)cfg.hostname);
   WebPage.replace(F("{apptext}"), str);
   return WebPage;
 }

void buildNetworkPage(String str){
  DBGF("buildNetworkPage(String str)")
  WebPage = buildPageFrame(str);
  WebPage.replace(F("{apppage}"), F(""));
  WebPage.replace(F("{mainpage}"), F(""));
  WebPage.replace(F("{networkpage}"), FPSTR(H_NETWORKPAGE));
  WebPage.replace(F("{confpage}"), F(""));
  sysflag.APTimeout = cfg.APTimeout;
}

void buildConfPage(String str){
  DBGF("buildConfPage(String str)")
  WebPage = buildPageFrame(str);
  WebPage.replace(F("{apppage}"), F(""));
  WebPage.replace(F("{mainpage}"), F(""));
  WebPage.replace(F("{networkpage}"), F(""));
  WebPage.replace(F("{confpage}"), FPSTR(H_CONFPAGE));
  sysflag.APTimeout = cfg.APTimeout;
}

void buildMainPage(String str){
  DBGF("buildMainPage(String str)")
  WebPage = buildPageFrame(str);
  WebPage.replace(F("{apppage}"), FPSTR(H_APPPAGE));
  WebPage.replace(F("{apppagemenu}"), F(""));
  WebPage.replace(F("{mainpage}"), FPSTR(H_MAINPAGE));
  WebPage.replace(F("{networkpage}"), F(""));
  WebPage.replace(F("{confpage}"), F(""));
  sysflag.APTimeout = cfg.APTimeout;
}

void buildAppPage(String str){
  DBGF("buildAppPage(String str)")
  WebPage = buildPageFrame(str);
  WebPage.replace(F("{apppage}"), FPSTR(H_APPPAGE));
  WebPage.replace(F("{apppagemenu}"), FPSTR(H_APPPAGEMENU));
  WebPage.replace(F("{mainpage}"), F(""));
  WebPage.replace(F("{networkpage}"), F(""));
  WebPage.replace(F("{confpage}"), F(""));
  sysflag.APTimeout = cfg.APTimeout;
}

String BuildURL (){
  String url;
  char buf[80];

  DBGF("BuildURL()");
  url += F("?Host=");
  url += (String)cfg.hostname;
  url += F("_");
  url += (String)cfg.MACAddress;
  url.replace (F(":"), F("_"));

  url += F("&IP=");
  url += WiFi.localIP().toString();

  url += F("&Type=");
  url += FNC_TYPE;

  url += "&Version=";
  url += VERNR;

  url += "&Hardw=";
  url += FPSTR(DEV_TYPE);

  url += "&Network=";
  url += FPSTR(cfg.SSID);

  url += "&MAC=";
  url += FPSTR(cfg.MACAddress);

  url += "&APName=";
  url += FPSTR(cfg.APname);

  url += "&Hash=";
  sprintf( buf, "0x%lx", cfg.hash );
  url += buf;

  url += FPSTR("&Size=");
  sprintf( buf, "0x%x", sizeof(cfg) );
  url += buf;

  url += "&TransCyc=";
  sprintf(buf, "%li", cfg.TransmitCycle);
  url += buf;

  url += "&MeasCyc=";
  sprintf(buf, "%li", cfg.MeasuringCycle);
  url += buf;

  url += "&PageReload=";
  sprintf(buf, "%li", cfg.PageReload);
  url += buf;

  url += "&Service=";
  url += FPSTR(cfg.service);

  url += "&ServerIP=";
  url += FPSTR(cfg.server);

  sprintf( buf, "%li", uptime );
  url += "&uptime=";
  url += buf;

  sprintf( buf, "%li", sysflag.CntPageDelivered );
  url += "&delivPages=";
  url += buf;

  sprintf( buf, "%li", sysflag.CntGoodTrans );
  url += "&goodTrans=";
  url += buf;

  sprintf( buf, "%li", sysflag.CntBadTrans );
  url += "&badTrans=";
  url += buf;

  sprintf( buf, "%i", cfg.LED );
  url += "&LED=";
  url += buf;

#if (H_DS1820 == H_TRUE)
  return url + BuildDS1820URL();
#elif (H_SWITCH == H_TRUE)
  return url + BuildSwitchURL();
#elif (H_TOF == H_TRUE)
  return url + BuildToFURL();
#else
#error "keine Hardwarefunktion definiert"
#endif
}

#if (H_DS1820 == H_TRUE)
String BuildDS1820URL (){
  char buf[80];
  String url;
//#error "hier sollte ich nicht sein"

  DBGF("BuildDS1820URL()");
  for(int i=0;i<numberOfDevices;i++){
    sprintf(buf, "%d", i);
    url += ("&Adress_") + String(buf) + F("=");
    url += GetAddressToString( devAddr[i] );
    url += ("&Value_") + String(buf) + F("=");
    dtostrf(tempDev[i], 2, 2, buf);
    url += buf;
  }
  return url;
}

String BuildDS1820Page(){
  String message="";
  char temperatureString[6];


  DBGF("BuildDS1820Page()");
  for(int i=0; i<numberOfDevices; i++){
    dtostrf(tempDev[i], 2, 2, temperatureString);
    DBGL( "Sending temperature: " );
    DBGLN( temperatureString );

    message += F("<tr><td>");
    message += GetAddressToString( devAddr[i] );
    message += F("</td>\r\n");
    message += F("<td>");
    message += temperatureString;
    message += F("</td></tr>\r\n");
    message += F("\r\n");
  }
  return message;
}

#elif (H_TOF == H_TRUE)
String BuildToFURL (){
  char DistanceString[80];
  String url = "";

  DBGF("BuildToFURL()");
  sprintf(DistanceString, "%d", ToFRange);
  url += "&distance=" + String(DistanceString);
  return url;
}

String BuildToFPage(){
  String message="";
  char DistanceString[10];
  char cyc[10];

  DBGF("BuildToFPage()");

  itoa (cfg.PageReload, cyc, 10);
  message += F("<meta http-equiv=\"refresh\" content=\"");
  message += String( cyc );
  message += F("\">");

  //message = F("<meta http-equiv=\"refresh\" content=\"1\">"); //"; URL=http://192.168.1.38/tof>");

  //ToFDistance();
  sprintf(DistanceString, "%d", ToFRange);
  if(ToFPresent == TOF_FALSE)
    message += "<h1 style=\"font-size:64px\">"+String(" ToF-Sensor failed ")+"</h1>";
  else{
    message += "<h1 style=\"font-size:128px\">"+String(DistanceString)+" mm"+"</h1>";
  }
  return message;
}

#elif (H_SWITCH == H_TRUE)
String BuildSwitchURL(){
  char buf[80];
  String url;

  DBGF("BuildSwitchURL()");
// CHN:
//  sprintf( buf, "%lu", uptime );
//  url += F("&uptime=");
//  url += (String)(buf);
  sprintf( buf, "%lu", ontime );
  url += F("&ontime=");
  url += (String)buf;
  sprintf( buf, "%lu", offtime );
  url += F("&offtime=");
  url += (String)buf;
  sprintf( buf, "%lu", cycles );
  url += F("&cycles=");
  url += (String)buf;
  url += F("&status=");
  if (DIG_READ(H_RELAY_PIN))
    url += F("AN");
  else
    url += F("AUS");

  return url;
}

String BuildSwitchPage(){
  String message;
  char cyc[10];

  DBGF("BuildSwitchHTML()");
  WebPage = FPSTR(H_APPPAGEMENU);

  message = F("");
  message += F("<h3>Schalter ist: ");
  if (DIG_READ(H_RELAY_PIN))
    message += F("AN</h3>");
  else
    message += F("AUS</h3>");

  itoa (cfg.PageReload, cyc, 10);
  DBGL("Pagereload: ");
  DBGL ( cyc );
  DBGNL(" sec.");
  message += F("<meta http-equiv=\"refresh\" content=\"");
  message += String( cyc );
  message += F(";URL=192.168.1.4/switch");
  message += F("\">");
  return message;
}

#endif

void BuildStatusPage(){
  char buf[80];
  String strbuf = F("");
  String output;

  DBGF("BuildStatusPage()")

  output += F("</h3>");
  output += Version;
  output += F("\r\n\r\n<br><br>");
  output += F("\r\n<br>Type: ");
  output += F(FNC_TYPE);
  output += F("\r\n<br>Hardw: ");
  output += F(DEV_TYPE);
  output += F("\r\n<br>MAC-Address: ");
  output += (String)cfg.MACAddress;
  output += F("\r\n<br>Network: ");
  output += (String)cfg.SSID;
  output += F("\r\n<br>Network-IP: ");
  output += WiFi.localIP().toString();
  output += F("\r\n<br>Devicename: ");
  output += (String)cfg.hostname;
  output += F("\r\n<br>AP-Name: ");
  output += (String)cfg.APname;
  output += F("\r\n<br>LED: ");
  cfg.LED == H_TRUE ? output += F("on ") : output += F("off ");
  output += F("\r\n<br>Hash: ");
  sprintf( buf, "0x%lx", cfg.hash );
  output += (String)buf;
  output += F("\r\n<br>cfg-Size: ");
  sprintf( buf, "0x%x", sizeof(cfg) );
  output += (String)buf;
  output += F("\r\n<br>");

  output += F("\r\n<br>uptime: ");
  sprintf( buf, "%lu days - %lu hours - %lu minutes - %lu seconds", uptime/86400, (uptime/3600)%24, (uptime/60)%60, uptime%60 );
  output += (String)buf;
#if (H_DS1820 == H_TRUE) || (H_TOF == H_TRUE)
  sprintf( buf, "\r\n<br>Measuring cycle: %li s (remaining: %li s)", cfg.MeasuringCycle, sysflag.MeasuringCycle );
  output += (String)buf;
#endif
  sprintf( buf, "\r\n<br>Transmit cycle: %li s (remaining: %li s)", cfg.TransmitCycle, sysflag.TransmitCycle );
  output += (String)buf;
  sprintf( buf, "\r\n<br>PageReload cycle: %lu s", cfg.PageReload );
  output += (String)buf;
  output += F("\r\n<br>Service: ");
  output += (String)cfg.service;
  output += F("\r\n<br>Server: ");
  output += (String)cfg.server;
  sprintf( buf, "\r\n\r\n<br><br>good Transmissions: %lu", sysflag.CntGoodTrans );
  output += (String)buf;
  sprintf( buf, "\r\n<br>bad Transmissions: %lu", sysflag.CntBadTrans );
  output += (String)buf;
  sprintf( buf, "\r\n<br>Pages delivered: %lu", sysflag.CntPageDelivered );
  output += (String)buf;
#if (H_DS1820 == H_TRUE) || (H_TOF == H_TRUE)
  sprintf( buf, "\r\n<br>Measurements: %lu", sysflag.CntMeasCyc );
  output += (String)buf;
#endif

#if (H_RELAY == H_TRUE)
  output += F("\r\n<br>ontime: ");
  sprintf( buf, "%lu days - %lu hours - %lu minutes - %lu seconds", ontime/86400, (ontime/3600)%24, (ontime/60)%60, ontime%60 );
  output += (String)buf;
  output += F("\r\n<br>offtime: ");
  sprintf( buf, "%lu days - %lu hours - %lu minutes - %lu seconds", offtime/86400, (offtime/3600)%24, (offtime/60)%60, offtime%60 );
  output += (String)buf;
  output += F("\r\n<br>Cycles:                 ");
  sprintf( buf, "%lu", cycles );
  output += (String)buf;
#endif
  output += F("</h6>");
  buildMainPage(output);
  sysflag.CntPageDelivered++;
  server.send(200, F(W_TEXT_HTML), WebPage);
}

/*  ---------------------------------------------------------------------------------------------------------

    some tool routines

    --------------------------------------------------------------------------------------------------------*/
// !!! is urltext really needed ???
int checkInput(String text, String URLText){
  String message="";
  String output="";
  int x;

  DBGF("checkInput()")

  output = FPSTR(H_NAME);
  output.replace(F("{nametext}"), text);
  output.replace(F("{urltext}"), URLText);
  DBGF(server.args())

  if( server.args() == 0 ){
    buildConfPage (output);
    DBGF("server.args=0")
    sysflag.CntPageDelivered++;
    server.send(200, F(W_TEXT_HTML), WebPage);
    return 0;
  }
  else
    if( server.args() == 1 && server.arg(server.args()-1).length() > 0){
      DBGF("server.args=cutted")
      DBGF("message is:")
      DBGF(message)
      buildConfPage( message );
      sysflag.CntPageDelivered++;
      server.send(200, F(W_TEXT_HTML), WebPage);
      x = server.arg(server.args()-1).substring(0, 30).length();
      return x < MAXCHAR ? x : MAXCHAR;  // cut everything whats longer than MAXCHAR
    }
    else {
      DBGF("server.args=leer")

      message = F("<p><font color=\"red\">keine Angabe ist keine gute Idee !!!</font></p>");
      message += output;
      buildConfPage(message);
      sysflag.CntPageDelivered++;
      server.send(200, F(W_TEXT_HTML), WebPage);
      return 0;
    }
  return 0;
}

_Bool string_isNumber(char const *str) {
  while(*str) {
    if(!isdigit(*str)) {
      return 0;
    }
    ++str;
  }
  return 1;
}

/*
  history:
  --------------------- V1.4
  19.01.21  ToF pages added
  --------------------- V1.4

  07.05.20  V1.30b: Switches sending uptime twice, removed
  06.05.20  V1.30a: new WiFi-state machine, sending a message after boot
  20.04.20  V1.30 from now we use platformio instead of the Arduiono stuff
            a lot of pointer castings changed
            string from checkinput is terminated with 0
            URL contains more information
  11.07.19  V1.24: switches dont send cyclic
  08.07.19  V1.23: some changes on the status-site
  05.03.19  V1.03: config or DS1820 added (Meascyx, Transcyc and pagereload)
            count the messages to server, the pagereloads (good and bad trys)
  03.03.19  V1.02: many changes on Webdesign and website structure
  02.03.19  V1.01 Website optimization (code and design)
            Server- and Servicename input added
  23.02.19  first Version wirh new Version management. Released for Sonoff S20 and Sonoff Basic
  19.02.19  V0.06 OTA implemented
            some little changes in Website source code and design
  19.01.19  V0.04 first version to re released
            debuging and error-check for all versions is to be done

  29.12.18  set deafults and some tiny stuff

  02.10.18  version 1.17
            device type added
  31.05.18  version 1.15
            cycles added
  17.05.18  version 1.13
            lifetimer added

  30.03.18  Version1.12
            scan displays RSSI and Crypt value in scan mode
            in status chip-id, mac and ip added
  24.03.18  version 1.11
            all PROGMEM-HTML strings changed for better readability in source code and on
            receivers

  03.01.18  version 1.10
            improvments website
            Name and network changing works
  02.03.18  Version 1.09
            network config added to webpage
  01.03.18  version 1.08
            new Webpage
  29.02.18  version 1.07
            improvements (Radio buttons for Scan, hostname can be changed etc.
  27.02.18  Version 1.06
            radio buttons testing
            STA-MODE-button added
            #defines for text added
  23.02.18  version 1.05
            Webserver scan Wifi

 todos:
  22.02.19  v0.07 crashes during scan with Advanced IP Scanner (or takes a long time until its working again)
            mesurement and transmit cycles for i.e. DS1820
            eraseconfig
  04.03.19  counting messages during uptime/lifetime good and bad ones and displaying them on Status-website

*/
